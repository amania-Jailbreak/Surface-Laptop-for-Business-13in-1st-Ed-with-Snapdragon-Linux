// SPDX-License-Identifier: BSD-3-Clause
/dts-v1/;
/plugin/;

/* A visible boot console before userspace backlight settings are restored.
 * Keep the existing PWM period, polarity, regulators and pin configuration.
 */
&{/backlight} {
    brightness-levels = <0 4 8 16 32 64 96 128 160 192 224 255>;
    default-brightness-level = <9>;
};
